MEMORY
{
    BOOTFLASH (RX) : ORIGIN = 0x00000000, LENGTH = 0x00008000
    APPFLASH (RX) : ORIGIN = 0x00000000, LENGTH = 0x000F8000
    SRAM (WX)  : ORIGIN = 0x20000000, LENGTH = 0x00040000
}

__bootloader_start__ = ORIGIN(BOOTFLASH);
__bootloader_size__ = LENGTH(BOOTFLASH);
__app_start__ = ORIGIN(APPFLASH);
__app_size__ = LENGTH(APPFLASH);